/* source key position labels */
#include "zmk-helpers/key-labels/36.h"

/* map Corne's extra keys */
#define X_LH  &kp ESC  // thumb row, left
#define X_RH  &kp TAB  // thumb row, right

/* activate bluetooth */
#define CONFIG_WIRELESS 1

/* source the main keymap */
#include "base.keymap"

/* use 5-column layout for Corne 5 */
ZMK_APPLY_MATRIX_TRANSFORM(five_column_transform)